## main/Kconfig.projbuild
```kconfig
menu "STB Buddy"

config STB_BUDDY_LOG_BYTES
    int "PSRAM UART history size in bytes"
    range 65536 6291456
    default 4194304

config STB_BUDDY_UART_BAUD
    int "Default STB UART baud rate"
    range 1200 3000000
    default 115200

config STB_BUDDY_SETUP_AP_PREFIX
    string "Setup access-point prefix"
    default "Buddy"

endmenu
```

## sdkconfig.defaults
```kconfig
CONFIG_IDF_TARGET="esp32s3"
CONFIG_APP_REPRODUCIBLE_BUILD=y
CONFIG_ESPTOOLPY_FLASHSIZE_8MB=y
CONFIG_PARTITION_TABLE_CUSTOM=y
CONFIG_PARTITION_TABLE_CUSTOM_FILENAME="partitions.csv"

CONFIG_SPIRAM=y
CONFIG_SPIRAM_MODE_OCT=y
CONFIG_SPIRAM_SPEED_80M=y
CONFIG_SPIRAM_BOOT_INIT=y
CONFIG_SPIRAM_USE_MALLOC=y
CONFIG_SPIRAM_MALLOC_ALWAYSINTERNAL=16384
CONFIG_SPIRAM_MALLOC_RESERVE_INTERNAL=32768

CONFIG_FREERTOS_HZ=1000
CONFIG_COMPILER_CXX_EXCEPTIONS=n
CONFIG_COMPILER_CXX_RTTI=n
CONFIG_ESP_TASK_WDT_EN=y
CONFIG_ESP_COREDUMP_ENABLE_TO_FLASH=y
CONFIG_BOOTLOADER_APP_ROLLBACK_ENABLE=y
CONFIG_LWIP_MAX_SOCKETS=16
```
